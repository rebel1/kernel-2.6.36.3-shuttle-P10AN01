## drivers/i2c/muxes/Kconfig
```kconfig
#
# Multiplexer I2C chip drivers configuration
#

menu "Multiplexer I2C Chip support"
	depends on I2C_MUX

config I2C_MUX_PCA954x
	tristate "Philips PCA954x I2C Mux/switches"
	depends on EXPERIMENTAL
	help
	  If you say yes here you get support for the Philips PCA954x
	  I2C mux/switch devices.

	  This driver can also be built as a module.  If so, the module
	  will be called pca954x.

config BOSCH_BMA150
   tristate "SMB380/BMA150 acceleration sensor support"
   depends on I2C=y
   help
     If you say yes here you get support for Bosch Sensortec's 
     acceleration sensors SMB380/BMA150.

config BMA_150_XY_FLIP
   bool "FLIP x y axis on BMA150"
   depends on BOSCH_BMA150
   help
     Flip X Y 

endmenu
```
